## boards/shields/catostyl/Kconfig.defconfig
```kconfig
if SHIELD_CATOSTYL_DONGLE

config ZMK_KEYBOARD_NAME
    default "Catostyl"

config ZMK_SPLIT_ROLE_CENTRAL
    default y


if ZMK_PIMORONI_PIM447

config I2C
    default y

config ZMK_POINTING
    default y

config ZMK_POINTING_SMOOTH_SCROLLING
    default y

endif # ZMK_PIMORONI_PIM447


if ZMK_DISPLAY

config I2C
    default y

config SSD1306
    default y

choice ZMK_DISPLAY_WORK_QUEUE
    default ZMK_DISPLAY_WORK_QUEUE_DEDICATED
endchoice

endif # ZMK_DISPLAY


endif


if SHIELD_CATOSTYL_LEFT || SHIELD_CATOSTYL_RIGHT

config ZMK_BATTERY_VOLTAGE_DIVIDER
    default y

endif


if SHIELD_CATOSTYL_DONGLE || SHIELD_CATOSTYL_LEFT || SHIELD_CATOSTYL_RIGHT

config ZMK_SPLIT
    default y

endif
```

## boards/shields/catostyl/Kconfig.shield
```kconfig
config SHIELD_CATOSTYL_DONGLE
    def_bool $(shields_list_contains,catostyl_dongle)

config SHIELD_CATOSTYL_LEFT
    def_bool $(shields_list_contains,catostyl_left)

config SHIELD_CATOSTYL_RIGHT
    def_bool $(shields_list_contains,catostyl_right)
```

## boards/shields/velella/Kconfig.shield
```kconfig
config SHIELD_VELELLA_DONGLE
    def_bool $(shields_list_contains,velella_dongle)

config SHIELD_VELELLA_LEFT
    def_bool $(shields_list_contains,velella_left)

config SHIELD_VELELLA_RIGHT
    def_bool $(shields_list_contains,velella_right)
```

## config/boards/shields/catostyl/Kconfig.defconfig
```kconfig
if ZMK_DISPLAY

config I2C
    default y

config SSD1306
    default y

choice ZMK_DISPLAY_WORK_QUEUE
    default ZMK_DISPLAY_WORK_QUEUE_DEDICATED
endchoice

endif


if LVGL

config LV_Z_VDB_SIZE
    default 64

config LV_DPI_DEF
    default 128

config LV_Z_BITS_PER_PIXEL
    default 1

choice LV_COLOR_DEPTH
    default LV_COLOR_DEPTH_1
endchoice

endif


if SHIELD_CATOSTYL_CENTER

config ZMK_KEYBOARD_NAME
    default "Catostyl"

config ZMK_SPLIT_BLE_ROLE_CENTRAL
    default y

config ZMK_USB
    default y

endif


if SHIELD_CATOSTYL_LEFT

config ZMK_KEYBOARD_NAME
    default "Catostyl L Peripheral"

endif


if SHIELD_CATOSTYL_RIGHT

config ZMK_KEYBOARD_NAME
    default "Catostyl R Peripheral"

endif


if SHIELD_CATOSTYL_LEFT || SHIELD_CATOSTYL_RIGHT

config ZMK_BATTERY_VOLTAGE_DIVIDER
    default y

endif


if SHIELD_CATOSTYL_CENTER || SHIELD_CATOSTYL_LEFT || SHIELD_CATOSTYL_RIGHT

config ZMK_SPLIT
    default y

config ZMK_BLE
    default y

endif
```

## config/boards/shields/catostyl/Kconfig.shield
```kconfig
config SHIELD_CATOSTYL_LEFT
    def_bool $(shields_list_contains,catostyl_left)

config SHIELD_CATOSTYL_RIGHT
    def_bool $(shields_list_contains,catostyl_right)
```

## config/west.yml
```yaml
manifest:
    remotes:
        - name: zmkfirmware
          url-base: https://github.com/zmkfirmware
        - name: 9u0vad15
          url-base: https://github.com/9u0vad15
        - name: t0bybr
          url-base: https://github.com/t0bybr
    projects:
        - name: zmk
          remote: zmkfirmware
          revision: main
          import: app/west.yml
        # modules
        - name: zmk-dongle-display
          remote: 9u0vad15
          revision: main
        - name: pim447
          remote: t0bybr
          revision: main
    self:
        path: config
```
