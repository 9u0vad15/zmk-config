#include "catostyl.dtsi"

&kscan0 {
    input-gpios =
        <&pro_micro 19 (GPIO_PULL_UP | GPIO_ACTIVE_LOW)>,
        <&pro_micro 20 (GPIO_PULL_UP | GPIO_ACTIVE_LOW)>,
        <&pro_micro 21 (GPIO_PULL_UP | GPIO_ACTIVE_LOW)>,
        <&pro_micro  1 (GPIO_PULL_UP | GPIO_ACTIVE_LOW)>,
        <&pro_micro  0 (GPIO_PULL_UP | GPIO_ACTIVE_LOW)>,
        <&pro_micro 10 (GPIO_PULL_UP | GPIO_ACTIVE_LOW)>,
        <&pro_micro 16 (GPIO_PULL_UP | GPIO_ACTIVE_LOW)>,
        <&pro_micro 14 (GPIO_PULL_UP | GPIO_ACTIVE_LOW)>,
        <&pro_micro 18 (GPIO_PULL_UP | GPIO_ACTIVE_LOW)>,
        <&pro_micro 15 (GPIO_PULL_UP | GPIO_ACTIVE_LOW)>,
        <&pro_micro  6 (GPIO_PULL_UP | GPIO_ACTIVE_LOW)>,
        <&pro_micro  5 (GPIO_PULL_UP | GPIO_ACTIVE_LOW)>,
        <&pro_micro  4 (GPIO_PULL_UP | GPIO_ACTIVE_LOW)>,
        <&pro_micro  2 (GPIO_PULL_UP | GPIO_ACTIVE_LOW)>,
        <&pro_micro  3 (GPIO_PULL_UP | GPIO_ACTIVE_LOW)>,
        <&pro_micro  7 (GPIO_PULL_UP | GPIO_ACTIVE_LOW)>,
        <&pro_micro  8 (GPIO_PULL_UP | GPIO_ACTIVE_LOW)>,
        <&pro_micro  9 (GPIO_PULL_UP | GPIO_ACTIVE_LOW)>;
};
